#include "lcd.h"
#include "gpio.h"
#include "spi.h"

static const uint8_t font5x7[][5] = {
    {0x00,0x00,0x00,0x00,0x00}, // ' '
    {0x00,0x00,0x5F,0x00,0x00}, // '!'
    {0x00,0x07,0x00,0x07,0x00}, // '"'
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    {0x61,0x51,0x49,0x45,0x43}, // 'Z'
};


void lcd_pin_init(void){


	gpio_init(GPIOB, 12, gpio_output, gpio_push_pull, 0);// CC1101 CS
	gpio_high(GPIOB, 12);// keep CC1101 off the bus

	gpio_init(GPIOB,3,gpio_af,gpio_push_pull,5);//SCK
	gpio_init(GPIOB,4,gpio_af,gpio_push_pull,5);//MISO
	gpio_init(GPIOB,5,gpio_af,gpio_push_pull,5);//MOSI
	gpio_init(GPIOB,6,gpio_output,gpio_push_pull,0);//CS lcd
	gpio_init(GPIOA,9,gpio_output,gpio_push_pull,0);// DC lcd Data/Command
	gpio_init(GPIOB,8,gpio_output,gpio_push_pull,0);// RESET lcd

	gpio_high(GPIOB, 6);//CS LCD HIGH

	spi_init(SPI1,1);
}

void lcd_cmd(uint8_t c){

	gpio_low(GPIOB, 6);//CS LCD LOW
	gpio_low(GPIOA, 9);//DC low

	spi_transfer(SPI1, c);
	gpio_high(GPIOB, 6);
}

void lcd_data(uint8_t c){

	gpio_low(GPIOB, 6);//CS LCD LOW
	gpio_high(GPIOA, 9);//DC high

	spi_transfer(SPI1, c);
	gpio_high(GPIOB, 6);
}

void delay(uint32_t n){
	for (volatile uint32_t i=0; i<n; i++);
}

void lcd_init(void){

	lcd_pin_init();

	gpio_low(GPIOB, 8);// RESET
	delay(1000);

	gpio_high(GPIOB, 8);
	delay(100000);

	//wake up
	lcd_cmd(0x11);

	delay(1000000);

	//style
	lcd_cmd(0x3A);
	lcd_data(0x55);

	//direction
	lcd_cmd(0x36);
	lcd_data(0x88);

	//screen enable
	lcd_cmd(0x29);
}


void lcd_fill(uint16_t x, uint16_t y, uint16_t w, uint16_t h, uint16_t color){


	lcd_cmd(0x2A);
	lcd_data(x >> 8);
	lcd_data(x & 0xFF);
	lcd_data((x+w-1) >> 8);
	lcd_data((x+w-1) & 0xFF);

	lcd_cmd(0x2B);
	lcd_data(y >> 8);
	lcd_data(y & 0xFF);
	lcd_data((y+h-1) >> 8);
	lcd_data((y+h-1) & 0xFF);

	// Start writing pixels
	lcd_cmd(0x2C);

	// Send the color for every pixel (high byte, then low byte)
	for (uint32_t i=0; i<(uint32_t)(w*h); i++){
		lcd_data(color >> 8);
		lcd_data(color & 0xFF);
	}
}

// fg = text color, bg = background color, size = scale (1, 2, 3...)
void lcd_char(uint16_t x, uint16_t y, char c, uint16_t fg, uint16_t bg, uint8_t size)
{
	for (uint8_t col = 0; col < 5; col++)
	{
		uint8_t bits = font5x7[c - ' '][col];

		for (uint8_t row = 0; row < 7; row++)
		{
			if (bits & (1 << row))
			{
				lcd_fill(x + col * size, y + row * size, size, size, fg);  // draw text color
			}
			else
			{
				lcd_fill(x + col * size, y + row * size, size, size, bg);  // draw background color
			}
		}
	}
}


void lcd_text(uint16_t x, uint16_t y, const char *s, uint16_t fg, uint16_t bg, uint8_t size)
{
	while (*s != '\0')
	{
		lcd_char(x, y, *s, fg, bg, size);
		x = x + 6 * size;
		s++;
	}
}


// Draws an integer (negative too) at (x, y).
// width = how many characters the field takes. Unused places are filled
//         with spaces, so a shorter new value fully erases the old one.
void lcd_number(uint16_t x, uint16_t y, int32_t n, uint8_t width,
                uint16_t fg, uint16_t bg, uint8_t size)
{
	uint8_t numbers_reversed[10];   // int32 has at most 10 digits
	uint8_t i = 0;                  // how many digits we found
	uint8_t count = 0;              // how many characters we drew

	// 1. Sign: draw '-' and continue with the positive value
	if (n < 0) {
		lcd_char(x, y, '-', fg, bg, size);
		x = x + 6 * size;
		count++;
		n = -n;
	}

	// 2. Split into digits (they come out reversed: 2048 -> 8, 4, 0, 2)
	while (1) {
		numbers_reversed[i] = n % 10;
		n = n / 10;
		i++;

		if (n == 0) {
			break;
		}
	}

	// 3. Draw the digits from the last found to the first (correct order)
	for (int t = i; t > 0; t--) {
		lcd_char(x, y, numbers_reversed[t - 1] + '0', fg, bg, size);
		x = x + 6 * size;
		count++;
	}

	// 4. Fill the rest of the field with spaces (erases old digits)
	while (count < width) {
		lcd_char(x, y, ' ', fg, bg, size);
		x = x + 6 * size;
		count++;
	}
}
